## sdkconfig.defaults
```kconfig
CONFIG_IDF_TARGET="esp32s2"
CONFIG_USB_ENABLED=y
CONFIG_USB_CDC_ENABLED=y
CONFIG_USB_MSC_ENABLED=y
CONFIG_ESP32S2_DEFAULT_CPU_FREQ_240=y
CONFIG_ESP32S2_DEFAULT_CPU_FREQ_MHZ=240
CONFIG_ESP_TASK_WDT_CHECK_IDLE_TASK_CPU0=n

CONFIG_BRIDGE_GPIO_BOOT=40
CONFIG_BRIDGE_GPIO_RST=35
CONFIG_BRIDGE_GPIO_RXD=37
CONFIG_BRIDGE_GPIO_TXD=39
CONFIG_BRIDGE_GPIO_TDI=36
CONFIG_BRIDGE_GPIO_TDO=34
CONFIG_BRIDGE_GPIO_TCK=38
CONFIG_BRIDGE_GPIO_TMS=33
CONFIG_BRIDGE_GPIO_LED1=7
CONFIG_BRIDGE_GPIO_LED2=8
CONFIG_BRIDGE_GPIO_LED3=9
CONFIG_BRIDGE_GPIO_LED1_ACTIVE=1
CONFIG_BRIDGE_GPIO_LED2_ACTIVE=1
CONFIG_BRIDGE_GPIO_LED3_ACTIVE=1
CONFIG_HTTPD_MAX_REQ_HDR_LEN=1024
CONFIG_FLASHMODE_QIO=y
CONFIG_ESPTOOLPY_FLASHFREQ_80M=y
CONFIG_ESPTOOLPY_FLASHSIZE_4MB=y
CONFIG_PARTITION_TABLE_CUSTOM=y
CONFIG_PARTITION_TABLE_CUSTOM_FILENAME="partitions.csv"
```
